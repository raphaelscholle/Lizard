## buildroot/buildroot-201902/configs/sun50iw6p1_arm32_longan_defconfig
```kconfig
BR2_arm=y
BR2_cortex_a53=y
BR2_ARM_FPU_VFPV4D16=y
BR2_SVN="svn"
BR2_JLEVEL=16
BR2_TOOLCHAIN_EXTERNAL=y
BR2_TOOLCHAIN_EXTERNAL_LINARO_ARM=y
BR2_TARGET_GENERIC_HOSTNAME="kunos"
BR2_TARGET_GENERIC_ISSUE="Welcome to Allwinner KunoOS Platform"
BR2_SYSTEM_BIN_SH_BASH=y
BR2_TARGET_GENERIC_GETTY_PORT="ttyS0"
BR2_TARGET_GENERIC_GETTY_BAUDRATE_115200=y
BR2_TARGET_TZ_INFO=y
BR2_ROOTFS_OVERLAY="$(TOPDIR)/../../platform/target/$(LICHEE_IC)/$(LICHEE_BOARD)/busybox-init-base-files"
BR2_ROOTFS_POST_BUILD_SCRIPT="$(TOPDIR)/../../platform/config/buildroot/post_build.sh"
BR2_PACKAGE_BUSYBOX_SHOW_OTHERS=y
BR2_PACKAGE_LIBCEDARC=y
BR2_PACKAGE_CEDARX=y
BR2_PACKAGE_BOOT_PLAY=y
BR2_PACKAGE_OTA_BURNBOOT=y
BR2_PACKAGE_SUNXI_GPU=y
BR2_PACKAGE_ALSA_UTILS=y
BR2_PACKAGE_ALSA_UTILS_AMIXER=y
BR2_PACKAGE_ALSA_UTILS_APLAY=y
BR2_PACKAGE_BZIP2=y
BR2_PACKAGE_GDB=y
BR2_PACKAGE_GDB_DEBUGGER=y
BR2_PACKAGE_LIBTOOL=y
BR2_PACKAGE_DOSFSTOOLS=y
BR2_PACKAGE_DOSFSTOOLS_MKFS_FAT=y
BR2_PACKAGE_E2FSPROGS=y
BR2_PACKAGE_NTFS_3G=y
BR2_PACKAGE_NTFS_3G_ENCRYPTED=y
BR2_PACKAGE_NTFS_3G_NTFSPROGS=y
BR2_PACKAGE_LIBSNDFILE=y
BR2_PACKAGE_LIBVORBIS=y
BR2_PACKAGE_CAIRO=y
BR2_PACKAGE_LIBDRM=y
BR2_PACKAGE_LIBPNG=y
BR2_PACKAGE_LIBUSB=y
BR2_PACKAGE_LIBDVDCSS=y
BR2_PACKAGE_LIBNETFILTER_CONNTRACK=y
BR2_PACKAGE_LIBPCAP=y
BR2_PACKAGE_NEON=y
BR2_PACKAGE_LIBGLIB2=y
BR2_PACKAGE_DHCP=y
BR2_PACKAGE_DHCP_CLIENT=y
BR2_PACKAGE_DHCPCD=y
BR2_PACKAGE_WPA_SUPPLICANT=y
BR2_PACKAGE_WPA_SUPPLICANT_CLI=y
BR2_PACKAGE_ANDROID_TOOLS=y
BR2_PACKAGE_VIM=y
BR2_TARGET_ROOTFS_EXT2=y
BR2_TARGET_ROOTFS_EXT2_4=y
BR2_TARGET_ROOTFS_EXT2_SIZE="512M"
# BR2_TARGET_ROOTFS_TAR is not set
BR2_PACKAGE_HOST_DOSFSTOOLS=y
BR2_PACKAGE_HOST_DTC=y
BR2_PACKAGE_HOST_GENEXT2FS=y
BR2_PACKAGE_HOST_GENIMAGE=y
BR2_PACKAGE_HOST_MTOOLS=y
```

## buildroot/buildroot-201902/configs/sun50iw9p1_longan_defconfig
```kconfig
BR2_aarch64=y
BR2_ARM_FPU_VFPV4D16=y
BR2_SVN="svn"
BR2_JLEVEL=16
BR2_TOOLCHAIN_EXTERNAL=y
BR2_TARGET_GENERIC_HOSTNAME="kunos"
BR2_TARGET_GENERIC_ISSUE="Welcome to Allwinner KunoOS Platform"
BR2_SYSTEM_BIN_SH_BASH=y
BR2_TARGET_GENERIC_GETTY_PORT="ttyS0"
BR2_TARGET_GENERIC_GETTY_BAUDRATE_115200=y
BR2_TARGET_TZ_INFO=y
BR2_ROOTFS_POST_BUILD_SCRIPT="$(TOPDIR)/../../platform/config/buildroot/post_build.sh"
BR2_PACKAGE_BUSYBOX_SHOW_OTHERS=y
BR2_PACKAGE_BOOT_PLAY=y
BR2_PACKAGE_OTA_BURNBOOT=y
BR2_PACKAGE_ALSA_UTILS=y
BR2_PACKAGE_ALSA_UTILS_AMIXER=y
BR2_PACKAGE_ALSA_UTILS_APLAY=y
BR2_PACKAGE_BZIP2=y
BR2_PACKAGE_GDB=y
BR2_PACKAGE_GDB_DEBUGGER=y
BR2_PACKAGE_LIBTOOL=y
BR2_PACKAGE_E2FSPROGS=y
BR2_PACKAGE_NTFS_3G=y
BR2_PACKAGE_NTFS_3G_ENCRYPTED=y
BR2_PACKAGE_NTFS_3G_NTFSPROGS=y
BR2_PACKAGE_LIBSNDFILE=y
BR2_PACKAGE_LIBVORBIS=y
BR2_PACKAGE_CAIRO=y
BR2_PACKAGE_LIBPNG=y
BR2_PACKAGE_LIBUSB=y
BR2_PACKAGE_LIBDVDCSS=y
BR2_PACKAGE_LIBNETFILTER_CONNTRACK=y
BR2_PACKAGE_LIBPCAP=y
BR2_PACKAGE_NEON=y
BR2_PACKAGE_LIBGLIB2=y
BR2_PACKAGE_LIBPTHREAD_STUBS=y
BR2_PACKAGE_WPA_SUPPLICANT=y
BR2_PACKAGE_WPA_SUPPLICANT_CLI=y
BR2_PACKAGE_ANDROID_TOOLS=y
BR2_PACKAGE_VIM=y
BR2_TARGET_ROOTFS_EXT2=y
BR2_TARGET_ROOTFS_EXT2_4=y
BR2_TARGET_ROOTFS_EXT2_SIZE="512M"
# BR2_TARGET_ROOTFS_TAR is not set
BR2_PACKAGE_HOST_DOSFSTOOLS=y
BR2_PACKAGE_HOST_DTC=y
BR2_PACKAGE_HOST_GENEXT2FS=y
BR2_PACKAGE_HOST_GENIMAGE=y
BR2_PACKAGE_HOST_MTOOLS=y
```

## buildroot/buildroot-201902/configs/sun8iw21p1_longan_defconfig
```kconfig
BR2_arm=y
BR2_cortex_a7=y
BR2_SVN="svn"
BR2_JLEVEL=16
BR2_TOOLCHAIN_EXTERNAL=y
BR2_TOOLCHAIN_EXTERNAL_LINARO_ARM=y
BR2_TARGET_GENERIC_HOSTNAME="Tina"
BR2_TARGET_GENERIC_ISSUE="Welcome to Allwinner Tina Platform"
BR2_ROOTFS_DEVICE_CREATION_DYNAMIC_EUDEV=y
# BR2_TARGET_ENABLE_ROOT_LOGIN is not set
BR2_SYSTEM_BIN_SH_BASH=y
BR2_TARGET_GENERIC_GETTY_PORT="ttyS0"
BR2_TARGET_GENERIC_GETTY_BAUDRATE_115200=y
BR2_ROOTFS_POST_BUILD_SCRIPT="$(TOPDIR)/../config/buildroot/post_build.sh"
BR2_PACKAGE_BUSYBOX_SHOW_OTHERS=y
BR2_PACKAGE_BZIP2=y
BR2_PACKAGE_GETTEXT=y
BR2_PACKAGE_LIBTOOL=y
# BR2_PACKAGE_EUDEV_ENABLE_HWDB is not set
BR2_PACKAGE_LIBUMP=y
BR2_PACKAGE_ALSA_LIB=y
BR2_PACKAGE_FDK_AAC=y
BR2_PACKAGE_LIBCUEFILE=y
BR2_PACKAGE_LIBREPLAYGAIN=y
BR2_PACKAGE_OPUS=y
BR2_PACKAGE_SBC=y
BR2_PACKAGE_SPEEX=y
BR2_PACKAGE_TAGLIB=y
BR2_PACKAGE_TINYALSA=y
BR2_PACKAGE_TREMOR=y
BR2_PACKAGE_VO_AACENC=y
BR2_PACKAGE_GNUTLS=y Allwinner KunoOS Platform"
BR2_ROOTFS_DEVICE_CREATION_DYNAMIC_EUDEV=y
BR2_SYSTEM_BIN_SH_BASH=y
BR2_TARGET_GENERIC_GETTY_PORT="ttyS0"
BR2_TARGET_GENERIC_GETTY_BAUDRATE_115200=y
BR2_ROOTFS_POST_BUILD_SCRIPT="$(TOPDIR)/../config/buildroot/post_build.sh"
BR2_PACKAGE_BUSYBOX_SHOW_OTHERS=y
BR2_AW_GSTREAMER1=y
BR2_AW_WESTON=y
BR2_PACKAGE_LONGAN_INFO=y
BR2_PACKAGE_LIBCEDARC=y
BR2_PACKAGE_OTA_UPGRADE=y
BR2_PACKAGE_LIBGPG_ERROR=y
BR2_PACKAGE_OPENSSL=y
BR2_PACKAGE_LIBJPEG=y
BR2_PACKAGE_LIBRSVG=y
BR2_PACKAGE_LIBSVG_CAIRO=y
BR2_PACKAGE_LIBVA=y
BR2_PACKAGE_OPENJPEG=y
BR2_PACKAGE_WAYLAND=y
BR2_PACKAGE_WAYLAND_PROTOCOLS=y
BR2_PACKAGE_WEBP=y
BR2_PACKAGE_LIBINPUT=y
BR2_PACKAGE_LIBUSB=y
BR2_PACKAGE_LIBXKBCOMMON=y
BR2_PACKAGE_TSLIB=y
BR2_PACKAGE_JSON_C=y
BR2_PACKAGE_LIBASS=y
BR2_PACKAGE_LIBDVDREAD=y
BR2_PACKAGE_LIBMMS=y
BR2_PACKAGE_LIBMPEG2=y
BR2_PACKAGE_LIBOPENH264=y
BR2_PACKAGE_LIBTHEORA=y
BR2_PACKAGE_LIBVPX=y
BR2_PACKAGE_X264=y
BR2_PACKAGE_X265=y
BR2_PACKAGE_LIBCURL=y
BR2_PACKAGE_LIBSOUP=y
BR2_PACKAGE_LIBSRTP=y
BR2_PACKAGE_NEON=y
BR2_PACKAGE_RTMPDUMP=y
BR2_PACKAGE_LIBBSD=y
BR2_PACKAGE_LIBICAL=y
BR2_PACKAGE_PCRE_16=y
BR2_PACKAGE_PCRE_32=y
# BR2_PACKAGE_IFUPDOWN_SCRIPTS is not set
BR2_PACKAGE_GETENT=y
BR2_PACKAGE_VIM=y
# BR2_PACKAGE_VIM_RUNTIME is not set
BR2_TARGET_ROOTFS_EXT2=y
BR2_TARGET_ROOTFS_EXT2_4=y
BR2_TARGET_ROOTFS_EXT2_SIZE="512M"
# BR2_TARGET_ROOTFS_TAR is not set
BR2_PACKAGE_HOST_DOSFSTOOLS=y
BR2_PACKAGE_HOST_DTC=y
BR2_PACKAGE_HOST_GENEXT2FS=y
BR2_PACKAGE_HOST_GENIMAGE=y
BR2_PACKAGE_HOST_MTOOLS=y
```

## buildroot/config/buildroot/Config.in
```kconfig
menu "allwinner platform private package select"

menu "power"

endmenu

menu "system"
source "../config/buildroot/allwinner/system/ota-burnboot/Config.in"
endmenu

menu "usb"
source "../config/buildroot/allwinner/usb/mtp/Config.in"
source "../config/buildroot/allwinner/usb/adbd/Config.in"
endmenu

menu "utils"
source "../config/buildroot/allwinner/utils/boot-play/Config.in"
source "../config/buildroot/allwinner/utils/cpu_monitor/Config.in"
source "../config/buildroot/allwinner/utils/mtop/Config.in"
endmenu

menu "wireless"
source "../config/buildroot/allwinner/wireless/wifi-manager/Config.in"
endmenu

endmenu
```

## buildroot/config/buildroot/adbd/Config.in
```kconfig
config BR2_PACKAGE_ADBD
	bool "adbd"
	help
	  adbd is Android Debug Bridge Daemon in Tina Linux.

if BR2_PACKAGE_ADBD
config BR2_PACKAGE_ADBD_AUTH
	bool "adbd_auth_service"
	select BR2_PACKAGE_LIBAWADBAUTH
	help
	  adb auth service for Tina Linux

config BR2_PACKAGE_LIBAWADBAUTH
	bool "libawadbauth"
	help
	  adb auth lib for Tina Linux
endif
```

## buildroot/config/buildroot/allwinner/wireless/wifi-manager/Config.in
```kconfig
# wifi-manager
source "../config/buildroot/allwinner/wireless/wifi-manager/libwifimg/Config.in"
source "../config/buildroot/allwinner/wireless/wifi-manager/wifi-manager-demo/Config.in"
```

## buildroot/config/buildroot/cpu_monitor/Config.in
```kconfig
config BR2_PACKAGE_CPU_MONITOR
	bool "cpu_monitor"
	help
	  cpu_monitor for test
```

## buildroot/config/buildroot/gpu_um_pub/Config.in
```kconfig
config BR2_PACKAGE_SUNXI_GPU
	bool "Support SUNXI GPU"
	help
	  Support SUNXI GPU
```

## buildroot/config/buildroot/libdisplay/Config.in
```kconfig
config BR2_PACKAGE_LIBDISPLAY
	bool "sunxi libdisplay"
	help
	  sunxi libdisplay
```

## buildroot/config/buildroot/libsec_storage/Config.in
```kconfig
source "../config/buildroot/libsec_storage/libsst/Config.in"
source "../config/buildroot/libsec_storage/sst_test/Config.in"
```

## buildroot/config/buildroot/nativepower/Config.in
```kconfig
# nativepower
source "../config/buildroot/nativepower/libsuspend/Config.in"
source "../config/buildroot/nativepower/libnativepower/Config.in"
source "../config/buildroot/nativepower/libscenemanager/Config.in"
source "../config/buildroot/nativepower/nativepower_daemon/Config.in"
source "../config/buildroot/nativepower/nativepower_utils/Config.in"
```

## buildroot/config/buildroot/ota/Config.in
```kconfig
# ota
source "../config/buildroot/ota/misc-upgrade/Config.in"
source "../config/buildroot/ota/ota-burnboot/Config.in"
source "../config/buildroot/ota/ota-upgrade/Config.in"
```

## buildroot/config/buildroot/vs-modules/Config.in
```kconfig
config BR2_PACKAGE_VS_MODULES
	bool "vs modules"
	help
	  vs modules: platorm/vendor/vs
```

## buildroot/config/buildroot/wifi-firmware/Config.in
```kconfig
menu "wifi"
config BR2_PACKAGE_WIFI_FIRMWARE
	bool "wifi firmware"
	help
	  copy wifi firmware to rootfs

config BR2_PACKAGE_WIFI_NAME
	string "xr819"
	default ""
	depends on BR2_PACKAGE_WIFI_FIRMWARE
	help
		"Bass on BR2_PACKAGE_WIFI_NAME, copy "xxx wifi firmware to rootfs"

endmenu
```

## buildroot/config/buildroot/wifi-manager/Config.in
```kconfig
# wifi-manager
source "../config/buildroot/wifi-manager/libwifimg/Config.in"
source "../config/buildroot/wifi-manager/wifi-manager-demo/Config.in"
```
